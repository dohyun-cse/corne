## config/west.yml
```yaml
# manifest:
#   remotes:
#     - name: zmkfirmware
#       url-base: https://github.com/zmkfirmware
#     - name: dohyun-cse
#       url-base: https://github.com/dohyun-cse
#   projects:
#     - name: zmk
#       remote: zmkfirmware
#       revision: main
#       import: app/west.yml
#     - name: nice-view
#       remote: dohyun-cse
#       revision: main
#   self:
#     path: config
manifest:
  remotes:
    - name: zmkfirmware
      url-base: https://github.com/zmkfirmware
    - name: dohyun-cse
      url-base: https://github.com/dohyun-cse
  projects:
    - name: zmk
      remote: zmkfirmware
      revision: main
      import: app/west.yml
    - name: nice-view
      remote: dohyun-cse
      revision: main
  self:
    path: config
```
